/* The SD module (pins top to bottom: 3V3 CS MOSI CLK MISO GND) laid along the XIAO's right header row, so five
 * wires go straight across: 3V3-3V3, CS-D10, MOSI-D9, CLK-D8, MISO-D7; GND loops back up to the row's GND.
 * Any nRF52840 pin can take any SPIM signal. The left row (D0-D6) stays free for I2C (D4/D5), buttons and the
 * UART TX log (D6); uart0 (D6/D7) is disabled in the Omi overlay. */
&custom_spi {
    group1 {
        psels = <NRF_PSEL(SPIM_SCK, 1, 13)>,   /* D8 */
                <NRF_PSEL(SPIM_MOSI, 1, 14)>,  /* D9 */
                <NRF_PSEL(SPIM_MISO, 1, 12)>;  /* D7 */
    };
};
&spi2 { cs-gpios = <&gpio1 15 GPIO_ACTIVE_LOW>; };  /* D10 */
